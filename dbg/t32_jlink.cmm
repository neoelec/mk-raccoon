// SPDX-License-Identifier: GPL-2.0+
// Copyright (c) 2024 YOUNGJIN JOO (neoelec@gmail.com)

B::

PRIVATE &E_Func &E_Args
ENTRY &E_Func %LINE &E_Args
PRIVATE &ret

GOSUB &E_Func &E_Args
ENTRY %LINE &ret

ENDDO &ret

on_init_soc:
(
  RETURN
)

on_booting:
(
  EXEC &G_RCN_OS_Script_Path/symbol.cmm load
  SYStem.RESetTarget

  IF (FILE.EXIST(&G_RCN_PWD/custom.cmm))
    Break.Set main /CMD "Break.Delete main" /CMD "DO &G_RCN_PWD/custom.cmm on_booting"
  ELSE
    Break.Set main /CMD "Break.Delete main"

  RETURN
)

on_running:
(
  EXEC &G_RCN_OS_Script_Path/symbol.cmm load

  IF (FILE.EXIST(&G_RCN_PWD/custom.cmm))
    Break.Set main /CMD "DO &G_RCN_PWD/custom.cmm on_running"

  RETURN
)
