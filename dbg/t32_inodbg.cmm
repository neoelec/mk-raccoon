// SPDX-License-Identifier: GPL-2.0+
// Copyright (c) 2025 YOUNGJIN JOO (neoelec@gmail.com)

B::

PRIVATE &E_Func &E_Args
ENTRY &E_Func %LINE &E_Args
PRIVATE &ret

GOSUB debug_main &E_Func &E_Args
ENTRY %LINE &ret

ENDDO &ret

debug_main:
(
  PRIVATE &_func &_args
  ENTRY &_func %LINE &_args
  PRIVATE &ret

  GOSUB &_func &_args

  RETURN &ret
)

on_init_soc:
(
  RETURN
)

on_booting:
(
  DO &G_RCN_OS_Script_Path/symbol.cmm load
  SYStem.RESetTarget

  IF (FILE.EXIST(&G_RCN_PWD/custom.cmm))
    Break.Set setup /CMD "Break.Delete setup" /CMD "DO &G_RCN_PWD/custom.cmm on_main"
  ELSE
    Break.Set setup /CMD "Break.Delete setup"

  RETURN
)

on_running:
(
  DO &G_RCN_OS_Script_Path/symbol.cmm load

  IF (FILE.EXIST(&G_RCN_PWD/custom.cmm))
    Break.Set setup /CMD "DO &G_RCN_PWD/custom.cmm on_running"

  RETURN
)
