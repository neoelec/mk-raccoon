// SPDX-License-Identifier: GPL-2.0+
// Copyright (c) 2024 YOUNGJIN JOO (neoelec@gmail.com)

B::

PRIVATE &E_Func &E_Args
ENTRY &E_Func %LINE &E_Args
PRIVATE &ret

GOSUB &E_Func &E_Args
ENTRY %LINE &ret

ENDDO &ret

on_init_soc:
(
  SYStem.GDBconfig GDBSERVER OFF
  SYStem.GDBconfig EXTENDED OFF

  Break.SELect Program SOFT

  RETURN
)

;kpoint______________addr/line|code_____|label____|mnemonic________________|comment
;          XP:00007FFFF7FE58E0|4889E7______________mov________rdi,rsp           ; PC after attach
;          XP:00007FFFF7FE58E3|E8F80B00.           call       0x7FFFF7FE64E0
;          XP:00007FFFF7FE58E8|4989C4              mov        r12,rax           ; r12 == rax == _start
;          XP:00007FFFF7FE58EB|488B1424            mov        rdx,qword ptr [rsp]
;          ...
;          XP:00007FFFF7FE5917|4C89EC              mov        rsp,r13
;          XP:00007FFFF7FE591A|41FFE4              jmp        r12               ; call _start

on_booting:
(
  GOSUB __load_symbol
  GOSUB __break_main

  RETURN
)

__load_symbol:
(
  PRIVATE &start &start_phys

  Step.Over
  Step.Over

  &start=Register(RAX)

  Data.LOAD.Elf &G_RCN_Target_Elf_File /NoCODE
  &start_phys=ADDRESS.OFFSET(sYmbol.BEGIN(_start))
  sYmbol.Delete
  Data.LOAD.Elf &G_RCN_Target_Elf_File (&start-&start_phys) /NoCODE

  RETURN
)

__break_main:
(
  Break.Delete

  IF (FILE.EXIST(&G_RCN_PWD/custom.cmm))
    Break.Set main /CMD "Break.Delete main" /CMD "DO &G_RCN_PWD/custom.cmm on_main"
  ELSE
    Break.Set main /CMD "Break.Delete main"

  RETURN
)
